/* native_sim variant: the C5 overlay only switches on a sensor the SoC
 * already describes. native_sim has no die temperature sensor, so we
 * declare an emulated BMI160 (which reports SENSOR_CHAN_DIE_TEMP) and
 * point the same die-temp0 alias at it. The application source is not
 * touched.
 */
/ {
	aliases {
		die-temp0 = &bmi160;
	};
};

&i2c0 {
	status = "okay";

	bmi160: bmi160@68 {
		compatible = "bosch,bmi160";
		reg = <0x68>;
		status = "okay";
	};
};
