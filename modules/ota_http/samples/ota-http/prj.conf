## CMakeLists.txt
```
cmake_minimum_required(VERSION 3.20.0)
find_package(Zephyr REQUIRED HINTS $ENV{ZEPHYR_BASE})
project(ota_http_sample)
target_sources(app PRIVATE src/main.c)
```

## sample.yaml
```
sample:
  name: HTTP OTA
  description: Download firmware over HTTP into the MCUboot secondary slot
tests:
  workshop.ota_http:
    build_only: true
    platform_allow:
      - esp32c5_devkitc/esp32c5/hpcore
    tags: ota dfu
```

## prj.conf
```kconfig
CONFIG_MAIN_STACK_SIZE=4096

CONFIG_LOG=y
CONFIG_SHELL=y

CONFIG_NETWORKING=y
CONFIG_NET_IPV4=y
CONFIG_NET_DHCPV4=y
CONFIG_NET_SOCKETS=y
CONFIG_DNS_RESOLVER=y
CONFIG_NET_TCP=y
CONFIG_NET_SHELL=y

CONFIG_WIFI=y
CONFIG_NET_L2_WIFI_SHELL=y
CONFIG_NET_MGMT=y
CONFIG_NET_MGMT_EVENT=y
CONFIG_NET_MGMT_EVENT_INFO=y

CONFIG_BOOTLOADER_MCUBOOT=y
CONFIG_OTA_HTTP=y
CONFIG_OTA_HTTP_SHELL=y

CONFIG_NET_BUF_RX_COUNT=32
CONFIG_NET_BUF_TX_COUNT=32
CONFIG_NET_PKT_RX_COUNT=16
CONFIG_NET_PKT_TX_COUNT=16
```

## src/main.c
```c
#include <zephyr/kernel.h>
#include <zephyr/logging/log.h>
#include <zephyr/dfu/mcuboot.h>

#include <ota_http.h>

LOG_MODULE_REGISTER(main, LOG_LEVEL_INF);

/* Bump this in the image you serve, so you can tell the two apart on the
 * console after a swap.
 */
#define APP_VERSION "1"

int main(void)
{
	LOG_INF("ota-http sample, version " APP_VERSION);

	if (ota_http_pending_confirm()) {
		LOG_WRN("this image is running on trial");
		LOG_WRN("run 'ota confirm' to keep it, or reboot to go back");
	} else {
		LOG_INF("running a confirmed image");
	}

	LOG_INF("connect to a network, then:");
	LOG_INF("  ota download http://<host>/<image>.signed.bin");
	LOG_INF("  ota apply");
	LOG_INF("  ota reboot");

	return 0;
}
```
